## app/Kconfig
```kconfig
# Copyright (c) 2025 XiNGRZ <hi@xingrz.me>
# SPDX-License-Identifier: Apache-2.0

mainmenu "TICKLET"

menu "TICKLET"

rsource "Kconfig.logging"

module = TICKLET
module-str = ticklet
source "subsys/logging/Kconfig.template.log_config"

endmenu # TICKLET

source "Kconfig.zephyr"
```

## app/Kconfig.logging
```kconfig
# Copyright (c) 2025 XiNGRZ <hi@xingrz.me>
# SPDX-License-Identifier: Apache-2.0

config TICKLET_UART_LOGGING
	bool "Enable UART logging"
	select LOG
	select CONSOLE
	select SERIAL
	select UART_CONSOLE

config TICKLET_RTT_LOGGING
	bool "Enable RTT logging"
	select LOG
	select CONSOLE
	select USE_SEGGER_RTT
	select RTT_CONSOLE
```

## app/boards/alientek/dnesp32s3b/Kconfig
```kconfig
# Copyright (c) 2025 XiNGRZ <hi@xingrz.me>
# SPDX-License-Identifier: Apache-2.0

config HEAP_MEM_POOL_ADD_SIZE_BOARD
	int
	default 4096 if BOARD_DNESP32S3B_ESP32S3_PROCPU
	default 256 if BOARD_DNESP32S3B_ESP32S3_APPCPU
```

## app/west.yml
```yaml
# Copyright (c) 2025 XiNGRZ <hi@xingrz.me>
# SPDX-License-Identifier: Apache-2.0

manifest:
  projects:
    - name: zephyr
      url: https://github.com/xingrz/zephyr.git
      revision: dnesp32s3b/dev
      clone-depth: 10
      import:
        name-allowlist:
          - hal_espressif
          - lvgl
          - picolibc
          - segger
```
